## esp32_iot_system/sdkconfig.defaults
```kconfig
# ESP32 IoT System Configuration

# Target configuration
CONFIG_IDF_TARGET="esp32"

# WiFi Configuration
CONFIG_ESP32_WIFI_ENABLED=y
CONFIG_ESP32_WIFI_SW_COEXIST_ENABLE=y

# HTTP Server Configuration
CONFIG_HTTPD_MAX_REQ_HDR_LEN=1024
CONFIG_HTTPD_MAX_URI_LEN=512

# FreeRTOS Configuration
CONFIG_FREERTOS_HZ=1000

# Main task stack size
CONFIG_ESP_MAIN_TASK_STACK_SIZE=8192

# System configuration
CONFIG_ESP_SYSTEM_EVENT_TASK_STACK_SIZE=4096

# NVS Configuration
CONFIG_NVS_ENCRYPTION=n

# Log Configuration
CONFIG_LOG_DEFAULT_LEVEL_INFO=y
CONFIG_LOG_DEFAULT_LEVEL=3

# I2C Configuration
CONFIG_I2C_ENABLE_DEBUG_LOG=n

# GPIO Configuration
CONFIG_GPIO_ESP32_SUPPORT_SWITCH_SLP_PULL=y 
```
